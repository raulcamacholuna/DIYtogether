## components/diymon_bsp/Kconfig
```kconfig
# Fichero: ./components/diymon_bsp/Kconfig
# Fecha: 12/08/2025 - 07:45 pm
# Último cambio: Añadida opción para habilitar/deshabilitar la tarjeta SD.
# Descripción: Fichero de configuración para el BSP. Se añade una opción booleana
#              que permite compilar con o sin el soporte para la tarjeta SD.
#              Esto es crucial para resolver un conflicto de hardware en la placa,
#              donde el pin de la SD (GPIO20) interfiere con el monitor serie USB.

menu "DIYMON Board Options"

    config BSP_SD_CARD_ENABLED
        bool "Enable SD Card Support"
        default y
        help
            Enable this option to initialize and use the onboard SD card reader.

            WARNING: On the Waveshare ESP32-C6 Touch LCD board, the SD Card's
            Chip Select (CS) pin is connected to GPIO20. This pin is also used
            by the internal USB-JTAG interface for the serial monitor output.

            If you enable this option, YOU WILL LOSE THE SERIAL MONITOR LOGS
            as soon as the SD card is initialized.

            Disable this option during development and debugging if you need to
            see log output via the USB port. Re-enable it for final deployment.

endmenu
```

## components/diymon_bsp/Kconfig.projbuild
```kconfig
menu "DIYMON Board Support Package"
    choice DIYMON_TARGET_BOARD
        prompt "Target DIYMON Hardware"
        default DIYMON_BOARD_ORIGINAL
        help
            Select the specific hardware board you are compiling for.

        config DIYMON_BOARD_ORIGINAL
            bool "Placa Original (ESP32-S3)"

        config DIYMON_BOARD_WAVESHARE_C6
            bool "Waveshare ESP32-C6 LCD 1.9"

    endchoice
endmenu
```

## components_dependencies/esp_lvgl_port/Kconfig
```kconfig
menu "ESP LVGL PORT"

    config LVGL_PORT_ENABLE_PPA
        depends on SOC_PPA_SUPPORTED
        bool "Enable PPA for screen rotation"
        default n
        help
            Enables using PPA for screen rotation.

    # --- AÑADE ESTE BLOQUE COMPLETO ---
    config LV_TASK_STACK_SIZE
        int "LVGL task stack size"
        range 2048 16384
        default 4096
        help
            Stack size for the LVGL task in bytes.
            Increase this if you experience stack overflows, especially with complex animations.
            For the DIYTogether project, a value of 8192 is recommended to prevent crashes.

endmenu
```
